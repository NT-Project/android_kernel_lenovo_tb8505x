## drivers/input/misc/hx9031a/Kconfig
```kconfig
config INPUT_SAR_HX9031A
	tristate "TianYiHeXin hx9031a SAR device for MediaTek situation"
	default n
	help
	  TianYiHeXin sar device,
	  usually portable and electronic or electromechanical,
	  that detect distance between the body and device .
```

## drivers/input/touchscreen/mediatek/NT36523B/Kconfig
```kconfig
#
# Novatek NT36xxx touchscreen driver configuration
#
config TOUCHSCREEN_NT36523B
	bool "Novatek NT36523B"
	default y
	help
	  Say Y here if you have a Novatek NT36xxx touchscreen connected
	  to your system.

	  If unsure, say N.
```

## drivers/input/touchscreen/mediatek/focaltechm_touch/Kconfig
```kconfig
#
# Focaltech Touchscreen driver configuration
#

config TOUCHSCREENM_FTS
    bool "Focaltechm Touchscreen"
    depends on I2C
    default n
    help
      Say Y here if you have Focaltech touch panel.
      If unsure, say N.
      
config TOUCHSCREENM_FTS_DIRECTORY
    string "Focaltech ts directory name"
    default "focaltechm_touch"
    depends on TOUCHSCREEN_FTS
    
```
